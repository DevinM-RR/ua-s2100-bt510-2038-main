## west.yml
```yaml
manifest:
  remotes:
    - name: LairdCP
      url-base: https://github.com/LairdCP

  # Please add items below based on alphabetical order.
  # These dependencies may need updating if new features are added to the firmware.
  projects:
    - name: sdk-nrf
      path: nrf
      revision: 687493d3365292c47487cf91c89b921a7950589f
      remote: LairdCP
      import: true

  self:
    path: bt510
```
